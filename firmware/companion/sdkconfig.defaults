## firmware/companion/sdkconfig.defaults
```kconfig
CONFIG_IDF_TARGET="esp32"
CONFIG_ESPTOOLPY_FLASHSIZE_4MB=y
CONFIG_ESPTOOLPY_FLASHMODE_DIO=y
CONFIG_ESPTOOLPY_FLASHFREQ_40M=y
CONFIG_PARTITION_TABLE_CUSTOM=y
CONFIG_PARTITION_TABLE_CUSTOM_FILENAME="partitions.csv"
CONFIG_BOOTLOADER_APP_ROLLBACK_ENABLE=y
CONFIG_COMPILER_OPTIMIZATION_SIZE=y
CONFIG_ESP_MAIN_TASK_STACK_SIZE=12288
CONFIG_LOG_DEFAULT_LEVEL_INFO=y
```

## firmware/components/pw_app/Kconfig
```kconfig
menu "PassionWave pilot web access"
config PW_LAN_HTTP_LAB
    bool "Physically authorized, unencrypted LAN administration (pilot only)"
    default n
    help
        Explicit pilot exception. A physical code permits one LAN client for
        ten minutes over HTTP. Not secure LAN transport or a production feature.
endmenu
```

## firmware/components/pw_spotify/Kconfig
```kconfig
menu "PassionWave Spotify laboratory provider"
config PW_SPOTIFY_LAB
    bool "Enable direct Spotify Web API evaluation (laboratory only)"
    default n
    help
        Enables native control of Spotify Connect outputs for authorized test
        accounts. This is not a commercial product approval. Credentials are
        linked through the local USB PKCE flow, never through a web token form.
endmenu
```

## firmware/s3/sdkconfig.defaults
```kconfig
CONFIG_IDF_TARGET="esp32s3"
CONFIG_ESPTOOLPY_FLASHSIZE_16MB=y
CONFIG_ESPTOOLPY_FLASHMODE_DIO=y
CONFIG_ESPTOOLPY_FLASHFREQ_80M=y
CONFIG_SPIRAM=y
CONFIG_SPIRAM_MODE_OCT=y
CONFIG_SPIRAM_SPEED_80M=y
CONFIG_SPIRAM_USE_MALLOC=y
CONFIG_SPIRAM_MALLOC_ALWAYSINTERNAL=16384
CONFIG_SPIRAM_MALLOC_RESERVE_INTERNAL=65536
CONFIG_ESP_DEFAULT_CPU_FREQ_MHZ_240=y
CONFIG_PARTITION_TABLE_CUSTOM=y
CONFIG_PARTITION_TABLE_CUSTOM_FILENAME="partitions.csv"
CONFIG_BOOTLOADER_APP_ROLLBACK_ENABLE=y
CONFIG_COMPILER_OPTIMIZATION_SIZE=y
CONFIG_ESP_MAIN_TASK_STACK_SIZE=8192
CONFIG_ESP_HTTP_CLIENT_ENABLE_HTTPS=y
CONFIG_MBEDTLS_CERTIFICATE_BUNDLE=y
CONFIG_MBEDTLS_CERTIFICATE_BUNDLE_DEFAULT_FULL=y
CONFIG_HTTPD_MAX_REQ_HDR_LEN=1024
CONFIG_HTTPD_MAX_URI_LEN=256
CONFIG_LOG_DEFAULT_LEVEL_INFO=y
CONFIG_LV_USE_QRCODE=y
CONFIG_LV_USE_TJPGD=y
CONFIG_LV_FONT_MONTSERRAT_18=y
CONFIG_LV_FONT_MONTSERRAT_24=y
CONFIG_LV_FONT_MONTSERRAT_32=y
CONFIG_LV_USE_SYSMON=n
CONFIG_NVS_ENCRYPTION=y
# The default IDF provider is replaced before NVS initialization by pw_storage.
# A valid unused ID is necessary to compile IDF; no HMAC key is generated.
CONFIG_NVS_SEC_HMAC_EFUSE_KEY_ID=0

CONFIG_FREERTOS_HZ=1000
```
